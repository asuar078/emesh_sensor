## manifest/west.yml
```yaml
manifest:
  remotes:
    - name: lowlander
      url-base: https://github.com/lowlander
  projects:
    - name: zpp
      remote: lowlander
      revision: master
      path: modules/zpp
  self:
    path: manifest
```
